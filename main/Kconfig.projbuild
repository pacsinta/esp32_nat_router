## main/Kconfig.projbuild
```kconfig
menu "Example Configuration"

    config STORE_HISTORY
        bool "Store command history in flash"
        default y
        help
            Linenoise line editing library provides functions to save and load
            command history. If this option is enabled, initalizes a FAT filesystem
            and uses it to store command history.

endmenu

menu "NAT Router Uplink"

    choice UPLINK_TYPE
        prompt "Uplink interface"
        default WIFI_STA_UPLINK
        config WIFI_STA_UPLINK
            bool "WiFi STA"
        config ETH_UPLINK
            bool "Ethernet (LAN8720)"
        config ETH_DOWNLINK_W5500
            bool "WiFi STA + Ethernet LAN (W5500)"
    endchoice

    config ETH_SPI_HOST
        int "W5500 SPI host number (1=SPI2_HOST, 2=SPI3_HOST)"
        default 1
        depends on ETH_DOWNLINK_W5500

    config ETH_SPI_MISO_GPIO
        int "W5500 MISO GPIO"
        default 19
        depends on ETH_DOWNLINK_W5500

    config ETH_SPI_MOSI_GPIO
        int "W5500 MOSI GPIO"
        default 23
        depends on ETH_DOWNLINK_W5500

    config ETH_SPI_SCLK_GPIO
        int "W5500 SCLK GPIO"
        default 18
        depends on ETH_DOWNLINK_W5500

    config ETH_SPI_CS_GPIO
        int "W5500 SCS GPIO"
        default 5
        depends on ETH_DOWNLINK_W5500

    config ETH_SPI_INT_GPIO
        int "W5500 INT GPIO (-1 for polling)"
        default -1
        depends on ETH_DOWNLINK_W5500

    config ETH_SPI_RST_GPIO
        int "W5500 RST GPIO (-1 to disable)"
        default 16
        depends on ETH_DOWNLINK_W5500

    config ETH_SPI_POLL_MS
        int "W5500 polling period (ms)"
        default 2
        range 1 100
        depends on ETH_DOWNLINK_W5500

    config ETH_SPI_CLOCK_MHZ
        int "W5500 SPI clock (MHz)"
        default 10
        range 1 80
        depends on ETH_DOWNLINK_W5500

    config ETH_MDC_GPIO
        int "ETH MDC GPIO"
        default 23
        depends on ETH_UPLINK

    config ETH_MDIO_GPIO
        int "ETH MDIO GPIO"
        default 18
        depends on ETH_UPLINK

    config ETH_PHY_ADDR
        int "ETH PHY address"
        default 1
        depends on ETH_UPLINK

    config ETH_PHY_POWER_GPIO
        int "ETH PHY power GPIO (-1 for none)"
        default 16
        depends on ETH_UPLINK

    config ETH_RMII_CLK_OUTPUT_GPIO
        int "RMII clock output GPIO (-1 = input from PHY)"
        default -1
        depends on ETH_UPLINK
        help
            Set to the GPIO number on which the ESP32 should generate the 50 MHz
            RMII reference clock (e.g. GPIO 17 for the Olimex ESP32-POE-ISO).
            Leave at -1 when the PHY provides the clock (e.g. WT32-ETH01).

endmenu

menu "MQTT Home Assistant"

    config MQTT_HOMEASSISTANT
        bool "Enable MQTT Home Assistant integration"
        default y
        help
            Publishes router telemetry to an MQTT broker with
            Home Assistant auto-discovery. Adds ~58 KB flash.
            RAM is only used when a broker is configured and enabled.

    config MQTT_HA_BUFFER_SIZE
        int "MQTT buffer size (bytes)"
        default 1024
        depends on MQTT_HOMEASSISTANT

    config MQTT_DEFAULT_INTERVAL
        int "Default publish interval (seconds)"
        default 30
        depends on MQTT_HOMEASSISTANT
        range 5 3600

endmenu
```

## sdkconfig.defaults.w5500
```kconfig
# Wi-Fi STA upstream with W5500 Ethernet LAN downlink.
CONFIG_ETH_DOWNLINK_W5500=y
CONFIG_ETH_USE_SPI_ETHERNET=y
CONFIG_ETH_SPI_ETHERNET_W5500=y
CONFIG_ETH_SPI_HOST=1
CONFIG_ETH_SPI_MISO_GPIO=19
CONFIG_ETH_SPI_MOSI_GPIO=23
CONFIG_ETH_SPI_SCLK_GPIO=18
CONFIG_ETH_SPI_CS_GPIO=5
CONFIG_ETH_SPI_INT_GPIO=-1
CONFIG_ETH_SPI_RST_GPIO=16
CONFIG_ETH_SPI_CLOCK_MHZ=10
CONFIG_ETH_SPI_POLL_MS=2
```
